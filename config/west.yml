## config/west.yml
```yaml
manifest:
  remotes:
    - name: zmkfirmware
      url-base: https://github.com/zmkfirmware
  projects:
    - name: zmk
      remote: zmkfirmware
      revision: v0.3.0
      import: app/west.yml
    - name: zmk-ws2812-driver
      url: https://github.com/gohanda11/zmk-ws2812-driver
      path: modules/zmk-ws2812-driver
      revision: main
    - name: zmk-dongle-display
      url: https://github.com/englmaxi/zmk-dongle-display
      revision: v0.3.0
  self:
    path: config
```

## eyelash_corne_module/Kconfig
```kconfig
# eyelash_corne module Kconfig
# SPDX-License-Identifier: MIT

config ZMK_SPLIT_REMOTE_SENSORS
    bool "Receive keymap sensors from split peripherals"
    depends on ZMK_SPLIT_ROLE_CENTRAL
    default n

config ZMK_SPLIT_REMOTE_SENSOR_COUNT
    int "Number of remote keymap sensors"
    depends on ZMK_SPLIT_REMOTE_SENSORS
    range 1 8
    default 1

config ZMK_SPLIT_REMOTE_SENSOR_TRIGGERS_PER_ROTATION
    int "Remote encoder triggers per rotation"
    depends on ZMK_SPLIT_REMOTE_SENSORS
    range 1 360
    default 15
```

## eyelash_corne_module/boards/shields/eyelash_corne_dongle/Kconfig.defconfig
```kconfig
if SHIELD_EYELASH_CORNE_DONGLE

config ZMK_KEYBOARD_NAME
	default "Eyelash Corne"

config ZMK_SPLIT
	default y

config ZMK_SPLIT_ROLE_CENTRAL
	default y

endif
```

## eyelash_corne_module/boards/shields/eyelash_corne_dongle/Kconfig.shield
```kconfig
config SHIELD_EYELASH_CORNE_DONGLE
	def_bool $(shields_list_contains,eyelash_corne_dongle)
```

## eyelash_corne_module/dts/bindings/behaviors/zmk,behavior-led-col.yaml
```yaml
description: Cycle the color code of the LED-scan test cursor's current LED.

compatible: "zmk,behavior-led-col"

include: one_param.yaml
```

## eyelash_corne_module/dts/bindings/behaviors/zmk,behavior-led-idx.yaml
```yaml
description: Step the LED-scan test cursor to the next/previous LED index and light it.

compatible: "zmk,behavior-led-idx"

include: one_param.yaml
```

## patches/files/eyelash_corne_module/dts/bindings/behaviors/zmk,behavior-led-set.yaml
```yaml
description: LED set behavior — set a single LED color without clearing others. Use &led_set 255 0 to clear all and resume animation.

compatible: "zmk,behavior-led-set"

include: two_param.yaml
```

## patches/files/eyelash_corne_module/dts/bindings/behaviors/zmk,behavior-led-test.yaml
```yaml
description: LED test behavior for WS2812 strip

compatible: "zmk,behavior-led-test"

include: two_param.yaml
```
